## CMakeLists.txt
```
#
# Copyright (c) 2018 Nordic Semiconductor
#
# SPDX-License-Identifier: LicenseRef-Nordic-5-Clause
#
cmake_minimum_required(VERSION 3.20.0)

find_package(Zephyr REQUIRED HINTS $ENV{ZEPHYR_BASE})
project(peripheral_uart)

# NORDIC SDK APP START
target_sources(app PRIVATE
  src/main.c
  src/gatt_chars.c
)
target_sources(app INTERFACE src/gatt_chars.h)

# Include UART ASYNC API adapter
target_sources_ifdef(CONFIG_BT_NUS_UART_ASYNC_ADAPTER app PRIVATE
  src/uart_async_adapter.c
)

# NORDIC SDK APP END

zephyr_library_include_directories(${CMAKE_CURRENT_SOURCE_DIR})
```

## prj.conf
```kconfig
#
# Copyright (c) 2018 Nordic Semiconductor
#
# SPDX-License-Identifier: LicenseRef-Nordic-5-Clause
#

# Enable the UART driver
CONFIG_SERIAL=y

CONFIG_GPIO=y

# Make sure printk is printing to the UART console
CONFIG_CONSOLE=y

CONFIG_HEAP_MEM_POOL_SIZE=2048

CONFIG_BT=y
CONFIG_BT_PERIPHERAL=y
CONFIG_BT_DEVICE_NAME="Group 5 Robot side"
CONFIG_BT_MAX_CONN=1
CONFIG_BT_MAX_PAIRED=1

CONFIG_BT_SMP=y

# Enable bonding
CONFIG_BT_SETTINGS=y
CONFIG_FLASH=y
CONFIG_FLASH_PAGE_LAYOUT=y
CONFIG_FLASH_MAP=y
CONFIG_NVS=y
CONFIG_SETTINGS=y

# Enable DK LED and Buttons library
CONFIG_DK_LIBRARY=y

# This example requires more stack
CONFIG_MAIN_STACK_SIZE=2048
CONFIG_SYSTEM_WORKQUEUE_STACK_SIZE=4096

# Config logger
CONFIG_LOG=y
CONFIG_USE_SEGGER_RTT=y
CONFIG_LOG_BACKEND_RTT=y
CONFIG_LOG_BACKEND_UART=y
CONFIG_LOG_PRINTK=y

CONFIG_ASSERT=y
```

## src/main.c
```c
/*
 * Copyright (c) 2018 Nordic Semiconductor ASA
 *
 * SPDX-License-Identifier: LicenseRef-Nordic-5-Clause
 */

/** @file
 *  @brief Nordic UART Bridge Service (NUS) sample
 */
#include "uart_async_adapter.h"
#include "gatt_chars.h"


#include <zephyr/types.h>
#include <zephyr/kernel.h>
#include <zephyr/drivers/uart.h>
#include <zephyr/usb/usb_device.h>

#include <zephyr/device.h>
#include <zephyr/devicetree.h>
#include <soc.h>

#include <zephyr/bluetooth/bluetooth.h>
#include <zephyr/bluetooth/uuid.h>
#include <zephyr/bluetooth/gatt.h>
#include <zephyr/bluetooth/hci.h>
#include <zephyr/settings/settings.h>



#include <bluetooth/services/nus.h>

#include <dk_buttons_and_leds.h>

#include <zephyr/settings/settings.h>

#include <stdio.h>

#include <zephyr/logging/log.h>

#include "freebot/freebot.h"

#define LOG_MODULE_NAME peripheral_uart
LOG_MODULE_REGISTER(LOG_MODULE_NAME);

#define STACKSIZE CONFIG_BT_NUS_THREAD_STACK_SIZE
#define PRIORITY 7

#define DEVICE_NAME CONFIG_BT_DEVICE_NAME
#define DEVICE_NAME_LEN	(sizeof(DEVICE_NAME) - 1)

#define RUN_STATUS_LED DK_LED1
#define RUN_LED_BLINK_INTERVAL 1000

#define CON_STATUS_LED DK_LED2

#define KEY_PASSKEY_ACCEPT DK_BTN1_MSK
#define KEY_PASSKEY_REJECT DK_BTN2_MSK

#define UART_BUF_SIZE CONFIG_BT_NUS_UART_BUFFER_SIZE
#define UART_WAIT_FOR_BUF_DELAY K_MSEC(50)
#define UART_WAIT_FOR_RX CONFIG_BT_NUS_UART_RX_WAIT_TIME

static fb_motor_angle_t motor_angles;
static fb_motor_speed_t motor_speeds;


static K_SEM_DEFINE(freebot_init_ok, 0, 2);

static struct bt_conn *current_conn;
static struct bt_conn *auth_conn;

static const struct device *uart = DEVICE_DT_GET(DT_CHOSEN(nordic_nus_uart));
static struct k_work_delayable uart_work;

struct uart_data_t {
	void *fifo_reserved;
	uint8_t data[UART_BUF_SIZE];
	uint16_t len;
};

static K_FIFO_DEFINE(fifo_uart_tx_data);
static K_FIFO_DEFINE(fifo_uart_rx_data);


static const struct bt_data ad[] = {
	BT_DATA_BYTES(BT_DATA_FLAGS, (BT_LE_AD_GENERAL | BT_LE_AD_NO_BREDR)),
	BT_DATA(BT_DATA_NAME_COMPLETE, DEVICE_NAME, DEVICE_NAME_LEN),
};

static const struct bt_data sd[] = {
	BT_DATA_BYTES(BT_DATA_UUID128_ALL, BT_UUID_BOT_VAL),
};

static const struct device *const async_adapter;

// function to get voltage from freebot
static int read_volts() {
	int voltage = 0;
	for (int i = 0; i < 5; i++)
    {
		k_sleep(K_MSEC(200));
        voltage += 10; //TODO: remove: fb_v_measure();
    }
	return voltage / 5;
}

static int app_volt_cb() {
	return read_volts();
}

//TODO: remove comments: 
static int read_rpm() {
    // fb_get_motor_speed(&motor_speeds);

	// int rpm = motor_speeds.front_left;
	// if (
	// 	motor_speeds.front_left != rpm || motor_speeds.front_right != rpm ||  
	// 	motor_speeds.back_left != rpm || motor_speeds.back_right != rpm)
	// {
	// 	LOG_INF("App_rpm_read: rpm of wheels not same!");
	// }
	return 200;
}

static int read_rpm_avg() {
	int rpm = 0;
	for (int i = 0; i < 5; i++)
    {
		k_sleep(K_MSEC(200));
        rpm += read_rpm();
    }
	return rpm / 5;
}

// function to get current RPM from freebot
static int app_rpm_read_cb() {
	return read_rpm_avg();
}

//TODO: remove comments: 
// function to set the rpm of the freebot
static void app_rpm_write_cb(int rpm) {
	LOG_INF("Action: rpm changed");
	// motor_speeds.front_left = rpm;
    // motor_speeds.front_right = rpm;
    // motor_speeds.back_left = rpm;
    // motor_speeds.back_right = rpm;
}

void (*actions[10])() = {
        fb_straight_forw,
        fb_straight_back,
        fb_side_right,
        fb_side_left,
        fb_side_d45,
        fb_side_d135,
        fb_side_d225,
        fb_side_d315,
        fb_rotate_cw,
        fb_rotate_ccw
};

//TODO: remove comments: 
// function to set the next move of the freebot
static void app_move_cb(uint8_t move) {
	if (move >= 1 && move < 10) {
		//(*actions[move])();
		LOG_INF("Action: moved");
	} else {
		LOG_INF("App_move_cb, move index out of range %d", move);
	}
}

static struct freebot_svc_cb app_callbacks = {
	.rpm_write_cb 	= app_rpm_write_cb,
	.rpm_read_cb	= app_rpm_read_cb,
	.move_cb		= app_move_cb,
	.volt_cb		= app_volt_cb,
};


static void connected(struct bt_conn *conn, uint8_t err)
{
	char addr[BT_ADDR_LE_STR_LEN];

	if (err) {
		LOG_ERR("Connection failed (err %u)", err);
		return;
	}

	bt_addr_le_to_str(bt_conn_get_dst(conn), addr, sizeof(addr));
	LOG_INF("Connected %s", addr);

	current_conn = bt_conn_ref(conn);

	dk_set_led_on(CON_STATUS_LED);
}

static void disconnected(struct bt_conn *conn, uint8_t reason)
{
	char addr[BT_ADDR_LE_STR_LEN];

	bt_addr_le_to_str(bt_conn_get_dst(conn), addr, sizeof(addr));

	LOG_INF("Disconnected: %s (reason %u)", addr, reason);

	if (auth_conn) {
		bt_conn_unref(auth_conn);
		auth_conn = NULL;
	}

	if (current_conn) {
		bt_conn_unref(current_conn);
		current_conn = NULL;
		dk_set_led_off(CON_STATUS_LED);
	}
}

static void security_changed(struct bt_conn *conn, bt_security_t level,
			     enum bt_security_err err)
{
	char addr[BT_ADDR_LE_STR_LEN];

	bt_addr_le_to_str(bt_conn_get_dst(conn), addr, sizeof(addr));

	if (!err) {
		LOG_INF("Security changed: %s level %u", addr, level);
	} else {
		LOG_WRN("Security failed: %s level %u err %d", addr,
			level, err);
	}
}

BT_CONN_CB_DEFINE(conn_callbacks) = {
	.connected    = connected,
	.disconnected = disconnected,
	.security_changed = security_changed,
};

static void auth_passkey_display(struct bt_conn *conn, unsigned int passkey)
{
	char addr[BT_ADDR_LE_STR_LEN];

	bt_addr_le_to_str(bt_conn_get_dst(conn), addr, sizeof(addr));

	LOG_INF("Passkey for %s: %06u", addr, passkey);
}

static void auth_passkey_confirm(struct bt_conn *conn, unsigned int passkey)
{
	char addr[BT_ADDR_LE_STR_LEN];

	auth_conn = bt_conn_ref(conn);

	bt_addr_le_to_str(bt_conn_get_dst(conn), addr, sizeof(addr));

	LOG_INF("Passkey for %s: %06u", addr, passkey);
	LOG_INF("Press Button 1 to confirm, Button 2 to reject.");
}


static void auth_cancel(struct bt_conn *conn)
{
	char addr[BT_ADDR_LE_STR_LEN];

	bt_addr_le_to_str(bt_conn_get_dst(conn), addr, sizeof(addr));

	LOG_INF("Pairing cancelled: %s", addr);
}


static void pairing_complete(struct bt_conn *conn, bool bonded)
{
	char addr[BT_ADDR_LE_STR_LEN];

	bt_addr_le_to_str(bt_conn_get_dst(conn), addr, sizeof(addr));

	LOG_INF("Pairing completed: %s, bonded: %d", addr, bonded);
}


static void pairing_failed(struct bt_conn *conn, enum bt_security_err reason)
{
	char addr[BT_ADDR_LE_STR_LEN];

	bt_addr_le_to_str(bt_conn_get_dst(conn), addr, sizeof(addr));

	LOG_INF("Pairing failed conn: %s, reason %d", addr, reason);
}


static struct bt_conn_auth_cb conn_auth_callbacks = {
	.passkey_display = auth_passkey_display,
	.passkey_confirm = auth_passkey_confirm,
	.cancel = auth_cancel,
};

static struct bt_conn_auth_info_cb conn_auth_info_callbacks = {
	.pairing_complete = pairing_complete,
	.pairing_failed = pairing_failed
};

static void bt_receive_cb(struct bt_conn *conn, const uint8_t *const data,
			  uint16_t len)
{
	int err;
	char addr[BT_ADDR_LE_STR_LEN] = {0};

	bt_addr_le_to_str(bt_conn_get_dst(conn), addr, ARRAY_SIZE(addr));

	LOG_INF("Received '%u' from: %s",data, addr);

	for (uint16_t pos = 0; pos != len;) {
		struct uart_data_t *tx = k_malloc(sizeof(*tx));

		if (!tx) {
			LOG_WRN("Not able to allocate UART send data buffer");
			return;
		}

		/* Keep the last byte of TX buffer for potential LF char. */
		size_t tx_data_size = sizeof(tx->data) - 1;

		if ((len - pos) > tx_data_size) {
			tx->len = tx_data_size;
		} else {
			tx->len = (len - pos);
		}

		memcpy(tx->data, &data[pos], tx->len);

		pos += tx->len;

		/* Append the LF character when the CR character triggered
		 * transmission from the peer.
		 */
		if ((pos == len) && (data[len - 1] == '\r')) {
			tx->data[tx->len] = '\n';
			tx->len++;
		}

		err = uart_tx(uart, tx->data, tx->len, SYS_FOREVER_MS);
		if (err) {
			k_fifo_put(&fifo_uart_tx_data, tx);
		}
	}
}

static struct bt_nus_cb nus_cb = {
	.received = bt_receive_cb,
};

void error(void)
{
	dk_set_leds_state(DK_ALL_LEDS_MSK, DK_NO_LEDS_MSK);

	while (true) {
		/* Spin for ever */
		k_sleep(K_MSEC(1000));
	}
}

static void num_comp_reply(bool accept)
{
	if (accept) {
		bt_conn_auth_passkey_confirm(auth_conn);
		LOG_INF("Numeric Match, conn %p", (void *)auth_conn);
	} else {
		bt_conn_auth_cancel(auth_conn);
		LOG_INF("Numeric Reject, conn %p", (void *)auth_conn);
	}

	bt_conn_unref(auth_conn);
	auth_conn = NULL;
}

void button_changed(uint32_t button_state, uint32_t has_changed)
{
	uint32_t buttons = button_state & has_changed;

	if (auth_conn) {
		if (buttons & KEY_PASSKEY_ACCEPT) {
			num_comp_reply(true);
		}

		if (buttons & KEY_PASSKEY_REJECT) {
			num_comp_reply(false);
		}
	}
}

static void configure_gpio(void)
{
	int err;

	err = dk_buttons_init(button_changed);
	if (err) {
		LOG_ERR("Cannot init buttons (err: %d)", err);
	}

	err = dk_leds_init();
	if (err) {
		LOG_ERR("Cannot init LEDs (err: %d)", err);
	}
}

int main(void)
{
	int blink_status = 0;
	int err = 0;

	configure_gpio();


	err = bt_conn_auth_cb_register(&conn_auth_callbacks);
	if (err) {
		printk("Failed to register authorization callbacks.\n");
		return 0;
	}

	err = bt_conn_auth_info_cb_register(&conn_auth_info_callbacks);
	if (err) {
		printk("Failed to register authorization info callbacks.\n");
		return 0;
	}

	err = bt_enable(NULL);
	if (err) {
		error();
	}

	LOG_INF("Bluetooth initialized");

	if (IS_ENABLED(CONFIG_SETTINGS)) {
		settings_load();
	}

	// init the freebot GATT services
	err = freebot_svc_init(&app_callbacks);	
	if (err) {		
		LOG_ERR("Failed to init freebot (err:%d)\n", err);
		return 0;
	}
	k_sem_give(&freebot_init_ok);
	k_sem_give(&freebot_init_ok);
	//TODO: remove when wanting to save bonding information
	bt_unpair(BT_ID_DEFAULT, BT_ADDR_ANY);

	err = bt_le_adv_start(BT_LE_ADV_CONN, ad, ARRAY_SIZE(ad), sd,
			      ARRAY_SIZE(sd));
	if (err) {
		LOG_ERR("Advertising failed to start (err %d)", err);
		return 0;
	}

	for (;;) {
		dk_set_led(RUN_STATUS_LED, (++blink_status) % 2);
		k_sleep(K_MSEC(RUN_LED_BLINK_INTERVAL));
	}
}

// threaded function for RPM notification
void notify_rpm_thread(void)
{
	// only do if freebot is set up ok
	k_sem_take(&freebot_init_ok, K_FOREVER);
	LOG_INF("RPM notification initialized");
	for (;;) {
		freebot_send_rpm_notify(read_rpm_avg());
	}
}

// threaded function for voltage notification
void notify_volt_thread(void)
{
	// only do if freebot is set up ok
	k_sem_take(&freebot_init_ok, K_FOREVER);
	LOG_INF("Voltage notification initialized");
	for (;;) {
		freebot_send_volt_notify(read_volts());
	}
}
// set up threads to notify central every 1 second
K_THREAD_DEFINE(notify_rpm_thread_id, STACKSIZE, notify_rpm_thread, NULL, NULL,
		NULL, PRIORITY, 0, 0);
K_THREAD_DEFINE(notify_volt_thread_id, STACKSIZE, notify_volt_thread, NULL, NULL,
		NULL, PRIORITY, 0, 0);
```

## src/gatt_chars.c
```c
#include <zephyr/types.h>
#include <stddef.h>
#include <string.h>
#include <errno.h>
#include <zephyr/sys/printk.h>
#include <zephyr/sys/byteorder.h>
#include <zephyr/kernel.h>

#include <zephyr/bluetooth/bluetooth.h>
#include <zephyr/bluetooth/hci.h>
#include <zephyr/bluetooth/conn.h>
#include <zephyr/bluetooth/uuid.h>
#include <zephyr/bluetooth/gatt.h>

#include "gatt_chars.h"

#include <zephyr/logging/log.h>

uint8_t voltage;
uint8_t rpm;
static struct freebot_svc_cb freebot_cb;

bool notify_rpm_enables;
bool notify_volt_enables;

static struct bt_gatt_notify_params not_RPM_params;
static struct bt_gatt_notify_params not_volt_params;


static ssize_t read_rpm(struct bt_conn *conn, const struct bt_gatt_attr *attr, void *buf,
			   uint16_t len, uint16_t offset) {
	
	// get a pointer to RPM which is passed in the BT_GATT_CHARACTERISTIC() and stored in attr->user_data
	const char *value = attr->user_data;

	printk("Read RPM, handle: %u, conn: %p\n", attr->handle, (void *)conn);
	//insert rpm code
	if (freebot_cb.rpm_read_cb) {
		// Call the application callback function to update the get the current value of the button
		rpm = freebot_cb.rpm_read_cb();
		return bt_gatt_attr_read(conn, attr, buf, len, offset, value, sizeof(*value));
	}
}

static ssize_t read_volt(struct bt_conn *conn, const struct bt_gatt_attr *attr, void *buf,
			   uint16_t len, uint16_t offset) {

	// get a pointer to voltage which is passed in the BT_GATT_CHARACTERISTIC() and stored in attr->user_data
	const char *value = attr->user_data;

	printk("Read voltage, handle: %u, conn: %p\n", attr->handle, (void *)conn);
	//insert voltage code
		if (freebot_cb.volt_cb) {
		// Call the application callback function to update the get the current value of the button
		voltage = freebot_cb.volt_cb();
		return bt_gatt_attr_read(conn, attr, buf, len, offset, value, sizeof(*value));
	}
}

static ssize_t write_rpm(struct bt_conn *conn, const struct bt_gatt_attr *attr, const void *buf,
			 uint16_t len, uint16_t offset, uint8_t flags) {
	
	printk("RPM write, handle: %u, conn: %p\n", attr->handle, (void *)conn);
//TODO: change conditions
	if (len != 1U) {
		printk("Write RPM: Incorrect data length\n");
		return BT_GATT_ERR(BT_ATT_ERR_INVALID_ATTRIBUTE_LEN);
	}

	if (offset != 0) {
		printk("Write RPM: Incorrect data offset\n");
		return BT_GATT_ERR(BT_ATT_ERR_INVALID_OFFSET);
	}

	//insert rpm code
	if (freebot_cb.rpm_write_cb) {
		// Read the received value
		char val = *((char *)buf);
		// Call the application callback function to update the LED state
		freebot_cb.rpm_write_cb(val);
		}

	return len;
}
static ssize_t write_move(struct bt_conn *conn, const struct bt_gatt_attr *attr, const void *buf,
			 uint16_t len, uint16_t offset, uint8_t flags) {
	
	printk("Write Move, handle: %u, conn: %p\n", attr->handle, (void *)conn);
//TODO: change conditions
	if (len != 1U) {
		printk("Write move: Incorrect data length\n");
		return BT_GATT_ERR(BT_ATT_ERR_INVALID_ATTRIBUTE_LEN);
	}

	if (offset != 0) {
		printk("Write move: Incorrect data offset\n");
		return BT_GATT_ERR(BT_ATT_ERR_INVALID_OFFSET);
	}
	//insert move code
	if (freebot_cb.move_cb) {
		// Read the received value
		uint8_t val = *((uint8_t *)buf);
			// Call the application callback function to update the LED state
			freebot_cb.move_cb(val); 
	}

	return len;
}


static void notify_read_RPM_changed(const struct bt_gatt_attr *attr,
				  uint16_t value)
{
		notify_rpm_enables = (value == BT_GATT_CCC_NOTIFY);
		printk("RPM notification changed to: %d\n", notify_rpm_enables);
}

static void notify_read_volt_changed(const struct bt_gatt_attr *attr,
				  uint16_t value)
{
		notify_volt_enables = (value == BT_GATT_CCC_NOTIFY);
		printk("voltage notification changed to: %d\n", notify_volt_enables);

}

//TODO: splits write rpm & read + notify rpm 
BT_GATT_SERVICE_DEFINE(freebot_svc, BT_GATT_PRIMARY_SERVICE(BT_UUID_BOT),
		       	/* STEP 3 - Create and add the Button characteristic */
		       	BT_GATT_CHARACTERISTIC(BT_UUID_BOT_RPM_WRITE,  
			   				BT_GATT_CHRC_WRITE,
					      	BT_GATT_PERM_WRITE_AUTHEN, 
							NULL, write_rpm, NULL),
				BT_GATT_CHARACTERISTIC(BT_UUID_BOT_RPM_READ,  
			   				BT_GATT_CHRC_READ | BT_GATT_CHRC_NOTIFY,
					      	BT_GATT_PERM_READ_AUTHEN, 
							read_rpm, NULL, &rpm),
				BT_GATT_CCC(notify_read_RPM_changed,
		    		BT_GATT_PERM_READ_AUTHEN | BT_GATT_PERM_WRITE_AUTHEN),
		       	BT_GATT_CHARACTERISTIC(BT_UUID_BOT_MOVE, 
			   				BT_GATT_CHRC_WRITE,
					      	BT_GATT_PERM_WRITE_AUTHEN, 
							NULL, write_move, NULL),
		       	/* STEP 4 - Create and add the LED characteristic. */
		       	BT_GATT_CHARACTERISTIC(BT_UUID_BOT_VOLT,  
			   				BT_GATT_CHRC_READ | BT_GATT_CHRC_NOTIFY,
					      	BT_GATT_PERM_READ_AUTHEN, 
							read_volt, NULL, &voltage),
				BT_GATT_CCC(notify_read_volt_changed,
		    		BT_GATT_PERM_READ_AUTHEN | BT_GATT_PERM_WRITE_AUTHEN),
);

int freebot_send_rpm_notify(int rpm) {
	if (!notify_rpm_enables) {
		return -EACCES;
	}
	return bt_gatt_notify(NULL, &freebot_svc.attrs[3], &rpm, sizeof(rpm));
}

int freebot_send_volt_notify(int volt)
{
	if (!notify_volt_enables) {
		return -EACCES;
	}
	return bt_gatt_notify(NULL, &freebot_svc.attrs[9], &volt, sizeof(volt));
}


/* A function to register application callbacks for the LED and Button characteristics  */
int freebot_svc_init(struct freebot_svc_cb *callbacks)
{
	if (callbacks) {
		freebot_cb.rpm_write_cb 	= callbacks->rpm_write_cb;
		freebot_cb.rpm_read_cb 		= callbacks->rpm_read_cb;
		freebot_cb.move_cb 			= callbacks->move_cb;
		freebot_cb.volt_cb 			= callbacks->volt_cb;
	}

	return 0;
}
```
